## Kconfig
```kconfig
# Copyright (c) 2026 Chriesibaum GmbH
# SPDX-License-Identifier: Apache-2.0

menu "cb_zephyr_module"

config CB_ZEPHYR_MODULE
	bool "Enable cb_zephyr_module"
	help
	  Enable the cb_zephyr_module Zephyr module.

if CB_ZEPHYR_MODULE

rsource "drivers/Kconfig"
rsource "lib/Kconfig"

endif # CB_ZEPHYR_MODULE

endmenu
```

## lib/Kconfig
```kconfig
# Copyright (c) 2026 Chriesibaum GmbH
# SPDX-License-Identifier: Apache-2.0

rsource "cb_error/Kconfig"
rsource "cb_info/Kconfig"
rsource "cb_sys/Kconfig"
```

## lib/cb_error/Kconfig
```kconfig
# Copyright (c) 2026 Chriesibaum GmbH
# SPDX-License-Identifier: Apache-2.0

config CB_ERROR
	bool "Enable cb_zephyr_module error library"
	help
	  Enable the error handling library provided by cb_zephyr_module.
```

## lib/cb_sys/Kconfig
```kconfig
# Copyright (c) 2026 Chriesibaum GmbH
# SPDX-License-Identifier: Apache-2.0

config CB_SYS
	bool "Enable cb_zephyr_module sys library"
	help
	  Enable the sys utility library provided by cb_zephyr_module.

config CB_SYS_LED_HEARTBEAT_BPM
	int "System LED heartbeat BPM"
	range 20 240
	default 60
	depends on CB_SYS
	help
	  Heartbeat cycles per minute for the system PWM LED mode.
```
